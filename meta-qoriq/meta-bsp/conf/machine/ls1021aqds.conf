## meta-qoriq/meta-bsp/conf/machine/ls1021aqds.conf
```bitbake
#@TYPE: Machine
#@NAME: Freescale LS1021AQDS board
#@SOC: ls102xa
#@DESCRIPTION: Machine configuration for running LS1021AQDS in 32-bit mode
#@MAINTAINER: Zhenhua Luo <zhenhua.luo@freescale.com>

require conf/machine/include/qoriq-arm.inc
require conf/machine/include/tune-cortexa7.inc

SOC_FAMILY = "ls102xa"
UBOOT_CONFIG ??= "nor qspi nor-secboot lpuart sdcard"
UBOOT_CONFIG[nor] = "ls1021aqds_nor_config"
UBOOT_CONFIG[qspi] = "ls1021aqds_qspi_config"
UBOOT_CONFIG[nor-secboot] = "ls1021aqds_nor_secboot_config"
UBOOT_CONFIG[lpuart] = "ls1021aqds_lpuart_config"
UBOOT_CONFIG[sdcard] = "ls1021aqds_sdcard_config"

KERNEL_DEVICETREE = "ls1021a-qds.dtb"
KERNEL_DEFCONFIG ?= "${S}/arch/arm/configs/ls1021a_defconfig"   
```

## meta-qoriq/meta-bsp/conf/machine/ls1021atwr.conf
```bitbake
#@TYPE: Machine
#@NAME: Freescale LS1021ATWR board
#@SOC: ls102xa
#@DESCRIPTION: Machine configuration for running LS1021ATWR in 32-bit mode
#@MAINTAINER: Zhenhua Luo <zhenhua.luo@freescale.com>

require conf/machine/include/qoriq-arm.inc
require conf/machine/include/tune-cortexa7.inc

SOC_FAMILY = "ls102xa"

UBOOT_CONFIG ??= "nor sdcard lpuart"
UBOOT_CONFIG[nor] = "ls1021atwr_nor_config"
UBOOT_CONFIG[sdcard] = "ls1021atwr_sdcard_config,sdcard"
UBOOT_CONFIG[lpuart] = "ls1021atwr_lpuart_config"

KERNEL_DEVICETREE ?= "ls1021a-twr.dtb"
KERNEL_DEFCONFIG ?= "${S}/arch/arm/configs/ls1021a_defconfig"
```

## meta-qoriq/meta-bsp/conf/machine/t1024qds-64b.conf
```bitbake
#@TYPE: Machine
#@NAME: Freescale T1024QDS
#@SOC: t1024
#@DESCRIPTION: Machine configuration for Freescale QorIQ T1024 Development
#              System with ppce5500 core in 64b mode
#@MAINTAINER: Chunrong Guo <B40290@freescale.com>

require conf/machine/include/e5500-64b.inc

SOC_FAMILY = "t1:t1024"
UBOOT_CONFIG ??= "nor"
UBOOT_CONFIG[nor] = "T1024QDS_config"
UBOOT_CONFIG[d4] = "T1024QDS_D4_config"
UBOOT_CONFIG[nand] = "T1024QDS_NAND_config"
UBOOT_CONFIG[sdcard] = "T1024QDS_SDCARD_config"
UBOOT_CONFIG[spi] = "T1024QDS_SPIFLASH_config"
UBOOT_CONFIG[secure-boot] = "T1024QDS_SECURE_BOOT_config"
UBOOT_CONFIG[d4-secure-boot] = "T1024QDS_D4_SECURE_BOOT_config"
KERNEL_DEVICETREE ?= "t1024qds.dtb t1024qds-usdpaa.dtb \
    t1024qds-usdpaa-capwap.dtb \
"
KERNEL_DEFCONFIG ?= "${S}/arch/powerpc/configs/corenet64_fmanv3_smp_defconfig"

JFFS2_ERASEBLOCK = "0x10000"
QE_UCODE ?= "iram_Type_A_T1024_r1.0.bin"

EXTRA_IMAGEDEPENDS += "fm-ucode rcw qe-ucode"
```

## meta-qoriq/meta-bsp/conf/machine/t1024qds.conf
```bitbake
#@TYPE: Machine
#@NAME: Freescale T1024QDS
#@SOC: t1024
#@DESCRIPTION: Machine configuration for running T1024QDS in 32-bit mode
#@MAINTAINER: Chunrong Guo <B40290@freescale.com>

require conf/machine/include/e5500.inc

SOC_FAMILY = "t1:t1024"
UBOOT_CONFIG ??= "nor d4 nand sdcard spi secure-boot d4-secure-boot"
UBOOT_CONFIG[nor] = "T1024QDS_config"
UBOOT_CONFIG[d4] = "T1024QDS_D4_config"
UBOOT_CONFIG[nand] = "T1024QDS_NAND_config"
UBOOT_CONFIG[sdcard] = "T1024QDS_SDCARD_config"
UBOOT_CONFIG[spi] = "T1024QDS_SPIFLASH_config"
UBOOT_CONFIG[secure-boot] = "T1024QDS_SECURE_BOOT_config"
UBOOT_CONFIG[d4-secure-boot] = "T1024QDS_D4_SECURE_BOOT_config"
KERNEL_DEVICETREE ?= "t1024qds.dtb t1024qds-usdpaa.dtb \
    t1024qds-usdpaa-capwap.dtb \
"
KERNEL_DEFCONFIG ?= "${S}/arch/powerpc/configs/corenet32_fmanv3_smp_defconfig"

JFFS2_ERASEBLOCK = "0x10000"
```

## meta-qoriq/meta-bsp/conf/machine/t1040rdb-64b.conf
```bitbake
#@TYPE: Machine
#@NAME: Freescale T1040RDB
#@SOC: t1040
#@DESCRIPTION: Machine configuration for running T1040RDB in 64-bit mode
#@MAINTAINER: Chunrong Guo <B40290@freescale.com>

require conf/machine/include/e5500-64b.inc

SOC_FAMILY = "t1:t1040"
UBOOT_CONFIG ??= "nor secure-boot"
UBOOT_CONFIG[nor] = "T1040RDB_config"
UBOOT_CONFIG[secure-boot] = "T1040RDB_SECURE_BOOT_config"
KERNEL_DEVICETREE ?= "t1040rdb.dtb t1040rdb-usdpaa.dtb"
KERNEL_DEFCONFIG ?= "${S}/arch/powerpc/configs/corenet64_fmanv3_smp_defconfig"

JFFS2_ERASEBLOCK = "0x10000"
QE_UCODE ?= "iram_Type_A_T1040_r1.0.bin"
```

## meta-qoriq/meta-bsp/conf/machine/t1040rdb.conf
```bitbake
#@TYPE: Machine
#@NAME: Freescale T1040RDB
#@SOC: t1040
#@DESCRIPTION: Machine configuration for Freescale QorIQ T1040 Reference
#              Design Board with ppce5500 core in 32b mode
#@MAINTAINER: Chunrong Guo <B40290@freescale.com>

require conf/machine/include/e5500.inc

SOC_FAMILY = "t1:t1040"
UBOOT_CONFIG ??= "nor secure-boot"
UBOOT_CONFIG[nor] = "T1040RDB_config"
UBOOT_CONFIG[secure-boot] = "T1040RDB_SECURE_BOOT_config"
KERNEL_DEVICETREE ?= "t1040rdb.dtb t1040rdb-usdpaa.dtb"
KERNEL_DEFCONFIG ?= "${S}/arch/powerpc/configs/corenet32_fmanv3_smp_defconfig"

JFFS2_ERASEBLOCK = "0x10000"
QE_UCODE ?= "iram_Type_A_T1040_r1.0.bin"
```

## meta-qoriq/meta-bsp/conf/machine/t1042rdb-64b.conf
```bitbake
#@TYPE: Machine
#@NAME: Freescale T1042RDB
#@SOC: t1042
#@DESCRIPTION: Machine configuration for Freescale QorIQ T1042 Reference
#              Design Board with ppce5500 core in 64b mode
#@MAINTAINER: Chunrong Guo <B40290@freescale.com>

require conf/machine/include/e5500-64b.inc

SOC_FAMILY = "t1:t1042"
UBOOT_CONFIG ??= "nor"
UBOOT_CONFIG[nor] = "T1042RDB_config"
KERNEL_DEVICETREE ?= "t1042rdb.dtb"
KERNEL_DEFCONFIG ?= "${S}/arch/powerpc/configs/corenet64_fmanv3_smp_defconfig"

JFFS2_ERASEBLOCK = "0x10000"
QE_UCODE ?= "iram_Type_A_T1040_r1.0.bin"

EXTRA_IMAGEDEPENDS += "fm-ucode rcw hypervisor hv-cfg qe-ucode"
```

## meta-qoriq/meta-bsp/conf/machine/t1042rdb-pi-64b.conf
```bitbake
#@TYPE: Machine
#@NAME: Freescale T1042RDB-PI
#@SOC: t1042
#@DESCRIPTION: Machine configuration for running T1042RDB-PI in 64-bit mode
#@MAINTAINER: Chunrong Guo <B40290@freescale.com>

require conf/machine/include/e5500-64b.inc

SOC_FAMILY = "t1:t1042"
UBOOT_CONFIG ??= "nor nand sdcard spi secure-boot"
UBOOT_CONFIG[nor] = "T1042RDB_PI_config"
UBOOT_CONFIG[nand] = "T1042RDB_PI_NAND_config"
UBOOT_CONFIG[sdcard] = "T1042RDB_PI_SDCARD_config"                                                                           
UBOOT_CONFIG[spi] = "T1042RDB_PI_SPIFLASH_config"
UBOOT_CONFIG[secure-boot] = "T1042RDB_PI_SECURE_BOOT_config"
KERNEL_DEVICETREE ?= "t1042rdb_pi.dtb"
KERNEL_DEFCONFIG ?= "${S}/arch/powerpc/configs/corenet64_fmanv3_smp_defconfig"

JFFS2_ERASEBLOCK = "0x10000"

PREFERRED_PROVIDER_virtual/xserver ?= "xserver-xorg"
XSERVER = " \
    xserver-xorg \
    xf86-input-evdev \
    xf86-input-mouse \
    xf86-input-keyboard \
    xf86-video-fbdev \
"
```

## meta-qoriq/meta-bsp/conf/machine/t2080qds.conf
```bitbake
#@TYPE: Machine
#@NAME: Freescale T2080QDS
#@SOC: t2080
#@DESCRIPTION: Machine configuration for running T2080QDS in 32-bit mode
#@MAINTAINER: Chunrong Guo <B40290@freescale.com>

require conf/machine/include/e6500.inc

SOC_FAMILY = "t2:t2080"
UBOOT_CONFIG ??= "nor sdcard spi nand srio-pcie-boot secure-boot"
UBOOT_CONFIG[nor] = "T2080QDS_config"
UBOOT_CONFIG[sdcard] = "T2080QDS_SDCARD_config"
UBOOT_CONFIG[spi] = "T2080QDS_SPIFLASH_config"
UBOOT_CONFIG[nand] = "T2080QDS_NAND_config"
UBOOT_CONFIG[srio-pcie-boot] = "T2080QDS_SRIO_PCIE_BOOT_config"
UBOOT_CONFIG[secure-boot] = "T2080QDS_SECURE_BOOT_config"

KERNEL_DEVICETREE ?= "t2080qds.dtb t2080qds-usdpaa.dtb"
KERNEL_DEFCONFIG ?= "${S}/arch/powerpc/configs/85xx/e6500rev2_defconfig"

JFFS2_ERASEBLOCK = "0x10000"
```

## meta-qoriq/meta-bsp/conf/machine/t4160qds-64b.conf
```bitbake
#@TYPE: Machine
#@NAME: Freescale T4160QDS-64B
#@SOC: t4160
#@DESCRIPTION: Machine configuration for running T4160QDS in 64-bit mode
#@MAINTAINER: Chunrong Guo <B40290@freescale.com>

require conf/machine/include/e6500-64b.inc

SOC_FAMILY = "t4:t4160"
UBOOT_CONFIG ??= "nor secure-boot"
UBOOT_CONFIG[nor] = "T4160QDS_config"
UBOOT_CONFIG[secure-boot] = "T4160QDS_SECURE_BOOT_config"
KERNEL_DEVICETREE ?= "t4240qds.dtb t4240qds-usdpaa.dtb"
KERNEL_DEFCONFIG ?= "${S}/arch/powerpc/configs/85xx/e6500rev2_defconfig"

JFFS2_ERASEBLOCK = "0x10000"
```

## meta-qoriq/meta-sdk/conf/distro/fsl-qoriq.conf
```bitbake
require conf/distro/poky.conf

DISTRO = "fsl-qoriq"
DISTRO_NAME = "QorIQ SDK (FSL Reference Distro)"
DISTRO_VERSION = "1.7"
SDK_VENDOR = "-fslsdk"
SDK_VERSION = "1.7"
MAINTAINER = "Freescale Yocto Team <meta-freescale@yoctoproject.org>"

TARGET_VENDOR = "-fsl"

SDK_NAME_PREFIX = "${DISTRO}"
SDK_NAME = "${DISTRO}-${TCLIBC}-${SDK_ARCH}-${TUNE_PKGARCH}"

SANITY_TESTED_DISTROS += " \
    Fedora-20 \n \
    LinuxMint-15 \n \
"

include conf/distro/include/fsl-qoriq-base.inc

INHERIT += "own-mirrors"
SOURCE_MIRROR_URL ?= "http://git.freescale.com/source/"

POKY_DEFAULT_DISTRO_FEATURES_remove = " opengl ptest"
DISTRO_FEATURES_DEFAULT_remove = " pcmcia 3g"
DISTRO_FEATURES_DEFAULT_append = " benchmark vfat ext2 mtd \
    alsa perl ppp python usbhost virtualization db"
```

## meta-qoriq/meta-toolchain/conf/layer.conf
```bitbake
# We have a packages directory, add to BBFILES
BBPATH := "${BBPATH}:${LAYERDIR}"

BBFILES += "${LAYERDIR}/recipes-*/*/*.bb*"

BBFILE_COLLECTIONS += "qoriq-toolchain"
BBFILE_PATTERN_qoriq-toolchain := "^${LAYERDIR}/"
BBFILE_PRIORITY_qoriq-toolchain = "5"
```
