## common/conf/bblayers.conf
```bitbake
LCONF_VERSION = "6"

BBPATH = "${TOPDIR}"
BSPDIR := "${@os.path.abspath(os.path.dirname(d.getVar('FILE', True)) + '/../..')}"

BBFILES ?= ""
BBLAYERS = " \
  ${BSPDIR}/sources/poky/meta \
  ${BSPDIR}/sources/poky/meta-yocto \
  \
  ${BSPDIR}/sources/meta-openembedded/meta-oe \
  ${BSPDIR}/sources/meta-openembedded/meta-multimedia \
  ${BSPDIR}/sources/meta-openembedded/meta-gnome \
  ${BSPDIR}/sources/meta-openembedded/meta-networking \
  ${BSPDIR}/sources/meta-openembedded/meta-python \
  ${BSPDIR}/sources/meta-openembedded/meta-filesystems \
  \
  ${BSPDIR}/sources/meta-freescale/common \
  \
  ${BSPDIR}/sources/meta-freescale/meta-imx/meta-bsp \
  ${BSPDIR}/sources/meta-freescale/meta-imx/meta-oe \
  ${BSPDIR}/sources/meta-freescale/meta-imx/meta-qt \
  \
  ${BSPDIR}/sources/meta-freescale/meta-qoriq/meta-bsp \
  ${BSPDIR}/sources/meta-freescale/meta-qoriq/meta-toolchain \
  \
  ${BSPDIR}/sources/meta-qt5 \
  ${BSPDIR}/sources/meta-fsl-demos \
  ${BSPDIR}/sources/meta-browser \
"
```

## conf/distro/fsl-imx-fb.conf
```bitbake
DISTRO = "fsl-imx-fb"

include conf/distro/include/fsl-imx-base.inc

# Remove conflicting backends.
DISTRO_FEATURES_remove = "x11 wayland directfb"

PREFERRED_PROVIDER_virtual/mesa = ""
```

## conf/distro/fsl-imx-wayland.conf
```bitbake
DISTRO = "fsl-imx-wayland"

include conf/distro/include/fsl-imx-base.inc

# Remove conflicting backends
DISTRO_FEATURES_remove = "x11 directfb"

PREFERRED_PROVIDER_virtual/mesa = ""
```

## conf/distro/fsl-imx-x11.conf
```bitbake
DISTRO = "fsl-imx-x11"

include conf/distro/include/fsl-imx-base.inc

# This distro supports the X11 backend.

# These are X11 specific
DISTRO_FEATURES_append = " \
    x11 \
"
```

## conf/distro/fsl-qoriq.conf
```bitbake
require conf/distro/poky.conf

DISTRO = "fsl-qoriq"
DISTRO_NAME = "QorIQ SDK (FSL Reference Distro)"
DISTRO_VERSION = "sdk-v1.9"
SDK_VENDOR = "-fslsdk"
SDK_VERSION = "sdk-v1.9"
MAINTAINER = "Freescale Yocto Team <meta-freescale@yoctoproject.org>"

TARGET_VENDOR = "-fsl"

SDK_NAME_PREFIX = "${DISTRO}"
SDK_NAME = "${DISTRO}-${TCLIBC}-${SDK_ARCH}-${TUNE_PKGARCH}"

SANITY_TESTED_DISTROS += " \
    Fedora-20 \n \
    LinuxMint-15 \n \
"

include conf/distro/include/fsl-qoriq-base.inc

POKY_DEFAULT_DISTRO_FEATURES_remove = " opengl ptest"
DISTRO_FEATURES_DEFAULT_remove = " pcmcia 3g"
DISTRO_FEATURES_DEFAULT_append = " benchmark vfat ext2 mtd \
    alsa perl ppp python usbhost virtualization db"

IMAGE_FSTYPES ?= "tar.gz ext2.gz ext2.gz.u-boot jffs2 ubi"

BINUVERSION_qoriq-ppc = "2.25"
GLIBCVERSION_qoriq-ppc = "2.20"
GCCVERSION_qoriq-arm = "linaro-4.9"
BINUVERSION_qoriq-arm = "linaro-2.25"
GLIBCVERSION_qoriq-arm = "linaro-2.20"
```

## conf/distro/include/fsl-imx-base.inc
```bitbake
require conf/distro/poky.conf

# This is the default distro configuration.

# Comment out the 2 lines below to use bluez4.
DISTRO_FEATURES_append_mx6 = " bluez5"
DISTRO_FEATURES_append_mx7 = " bluez5"

# Preferred Providers
PREFERRED_PROVIDER_u-boot_mx5 = "u-boot-fslc"
PREFERRED_PROVIDER_u-boot_mx6 = "u-boot-imx"
PREFERRED_PROVIDER_u-boot_mx7 = "u-boot-imx"

PREFERRED_PROVIDER_virtual/kernel_mx6 = "linux-imx"

# Preferred Versions
PREFERRED_VERSION_directfb-examples_mx6 = "1.7.0"

PREFERRED_VERSION_linux-imx_mx6 = "3.14.28"
PREFERRED_VERSION_mfgtool-linux-imx_mx6 = "3.14.28"
PREFERRED_VERSION_u-boot-imx_mx6 = "2014.04"
PREFERRED_VERSION_u-boot-imx-mfgtool_mx6 = "2014.04"

MACHINE_GSTREAMER_1_0_PLUGIN_mx6 = "gst1.0-fsl-plugin"
MACHINE_GSTREAMER_1_0_PLUGIN_mx6q = "gst1.0-fsl-plugin"
MACHINE_GSTREAMER_1_0_PLUGIN_mx6dl = "gst1.0-fsl-plugin"
MACHINE_GSTREAMER_1_0_PLUGIN_mx6sl = "gst1.0-fsl-plugin"
MACHINE_GSTREAMER_1_0_PLUGIN_mx6sx = "gst1.0-fsl-plugin"
MACHINE_GSTREAMER_1_0_PLUGIN_mx7 = "gst1.0-fsl-plugin"

SANITY_TESTED_DISTROS += " \
    Ubuntu-12.04 \n \
"
```

## conf/distro/include/fsl-qoriq-base.inc
```bitbake
# Freescale QorIQ Distro default versions
PREFERRED_VERSION_qemu = "2.2.0+fsl"
PREFERRED_VERSION_make = "3.81"
PREFERRED_VERSION_ptpd = "2.3.1-rc2"
PREFERRED_VERSION_valgrind_e500v2 = "3.8.1+fsl"
PREFERRED_VERSION_openssl_qoriq-ppc = "1.0.1i"
PREFERRED_VERSION_hostapd = "2.4"

# When meta-openenbedded layer included, bitbake will complain that
# multiple providers are available for jpeg (jpeg, libjpeg-turbo)
PREFERRED_PROVIDER_jpeg ?= "jpeg"
PREFERRED_PROVIDER_jpeg-native ?= "jpeg-native"

QEMU_TARGETS_append_pn-qemu-native = " ppc64"
PREFERRED_PROVIDER_virtual/java-initial-native = "cacao-initial-native"
PREFERRED_PROVIDER_virtual/java-native = "jamvm-native"
PREFERRED_PROVIDER_virtual/javac-native = "ecj-bootstrap-native"
PREFERRED_VERSION_openjdk-6-jre = "6b27-1.12.8"
PREFERRED_VERSION_icedtea6-native = "1.8.11"
PREFERRED_VERSION_openjdk-7-jre = "25b30-2.3.12"
PREFERRED_VERSION_icedtea7-native = "2.1.3"
PREFERRED_PROVIDER_openjdk-6-jre = "openjdk-6-jre"
```

## conf/layer.conf
```bitbake
# We have a packages directory, add to BBFILES
BBPATH .= ":${LAYERDIR}"

BBFILES += "${LAYERDIR}/recipes-*/*/*.bb*"
BBFILES += "${LAYERDIR}/images/*.bb*"
BBFILES += "${LAYERDIR}/classes/*.bb*"

BBFILE_COLLECTIONS += "fsl"
BBFILE_PATTERN_fsl = "^${LAYERDIR}/"
BBFILE_PRIORITY_fsl = "5"

FSL_EULA_FILE = "${LAYERDIR}/EULA"

IMX_MIRROR ?= "http://www.freescale.com/lgfiles/NMG/MAD/YOCTO/"
QORIQ_MIRROR ?= "http://git.freescale.com/source/"
OSS_MIRROR ?= "http://download.ossystems.com.br/bsp/freescale/source/"

MIRRORS += " \
+        http://.*/.*  ${IMX_MIRROR} \n \
+        http://.*/.*  ${QORIQ_MIRROR} \n \
+        http://.*/.*  ${OSS_MIRROR} \n"

LICENSE_PATH += "${LAYERDIR}/custom-licenses"

# Let us add layer-specific bbappends which are only applied when that
# layer is included in our configuration
BBFILES += "${@' '.join('${LAYERDIR}/%s/recipes*/*/*.bbappend' % layer \
               for layer in BBFILE_COLLECTIONS.split())}"
```

## conf/machine/include/qoriq-ppc.inc
```bitbake
require conf/machine/include/qoriq.inc

MACHINE_EXTRA_RRECOMMENDS += "udev-rules-qoriq"

SERIAL_CONSOLES ?= "115200;ttyS0 115200;ttyS1 115200;ttyEHV0"
SERIAL_CONSOLES_CHECK ?= "${SERIAL_CONSOLES}"

MACHINEOVERRIDES .= ":qoriq-ppc"
```

## conf/machine/t1042rdb-pi.conf
```bitbake
#@TYPE: Machine
#@NAME: Freescale T1042RDB-PI
#@SOC: t1042
#@DESCRIPTION: Machine configuration for Freescale QorIQ T1042 PI Reference
#              Design Board with ppce5500 core in 32b mode
#@MAINTAINER: Chunrong Guo <B40290@freescale.com>

require conf/machine/include/e5500.inc

SOC_FAMILY = "t1:t1042"
UBOOT_CONFIG ??= "nor nand sdcard spi secure-boot"
UBOOT_CONFIG[nor] = "T1042RDB_PI_config"
UBOOT_CONFIG[nand] = "T1042RDB_PI_NAND_config"
UBOOT_CONFIG[sdcard] = "T1042RDB_PI_SDCARD_config"
UBOOT_CONFIG[spi] = "T1042RDB_PI_SPIFLASH_config"
UBOOT_CONFIG[secure-boot] = "T1042RDB_PI_SECURE_BOOT_config"
KERNEL_DEVICETREE ?= "t1042rdb_pi.dtb"
KERNEL_DEFCONFIG ?= "${S}/arch/powerpc/configs/corenet32_fmanv3_smp_defconfig"

JFFS2_ERASEBLOCK = "0x10000"
QE_UCODE ?= "iram_Type_A_T1040_r1.0.bin"

PREFERRED_PROVIDER_virtual/xserver ?= "xserver-xorg"
XSERVER = " \
    xserver-xorg \
    xf86-input-evdev \
    xf86-input-mouse \
    xf86-input-keyboard \
    xf86-video-fbdev \
"

EXTRA_IMAGEDEPENDS += "fm-ucode rcw"
```

## meta-imx/meta-bsp/conf/layer.conf
```bitbake
# We have a conf and classes directory, add to BBPATH
BBPATH .= ":${LAYERDIR}"

# We have a packages directory, add to BBFILES
BBFILES += "${LAYERDIR}/recipes-*/*/*.bb \
            ${LAYERDIR}/recipes-*/*/*.bbappend"

BBFILE_COLLECTIONS += "imx"
BBFILE_PATTERN_imx := "^${LAYERDIR}/"
BBFILE_PRIORITY_imx = "5"

FSL_EULA_FILE = "${LAYERDIR}/EULA"

# set this to avoid changing all the recipes that use it
FSL_MIRROR ?= "${IMX_MIRROR}"

# Let us add layer-specific bbappends which are only applied when that
# layer is included in our configuration
BBFILES += "${@' '.join('${LAYERDIR}/%s/recipes*/*/*.bbappend' % layer \
               for layer in BBFILE_COLLECTIONS.split())}"
```

## meta-imx/meta-sdk/conf/distro/fsl-imx-dfb.conf
```bitbake
require conf/distro/fsl-imx-x11.conf

DISTRO = "fsl-imx-dfb"

# Remove backends that conflict with directfb and add directfb

DISTRO_FEATURES_remove = "x11 wayland "
DISTRO_FEATURES_append = " directfb "
```

## meta-imx/meta-sdk/conf/distro/fsl-imx-fb.conf
```bitbake
require conf/distro/fsl-imx-x11.conf

DISTRO = "fsl-imx-fb"

# Remove conflicting backends.
DISTRO_FEATURES_remove = "x11 wayland directfb "

PREFERRED_PROVIDER_virtual/mesa = ""
```

## meta-imx/meta-sdk/conf/distro/fsl-imx-wayland.conf
```bitbake
require conf/distro/fsl-imx-x11.conf

DISTRO = "fsl-imx-wayland"


# Remove conflicting backends
DISTRO_FEATURES_remove = "x11 directfb "


PREFERRED_PROVIDER_virtual/mesa = ""
```

## meta-imx/meta-sdk/conf/distro/fsl-imx-xwayland.conf
```bitbake
DISTRO = "fsl-imx-xwayland"

include conf/distro/include/fsl-imx-base.inc

DISTRO_FEATURES_append = " xwayland pam"

PREFERRED_PROVIDER_virtual/mesa = ""
```

## meta-imx/meta-sdk/conf/distro/include/fsl-imx-base.inc
```bitbake
require conf/distro/poky.conf

# This is the default distro configuration.

# for now use bluez4 as default
# Comment out the 2 lines below to use bluez4.
#DISTRO_FEATURES_append_mx6 = " bluez5"
#DISTRO_FEATURES_append_mx7 = " bluez5"

# Preferred Providers
PREFERRED_PROVIDER_u-boot_mx5 = "u-boot-fslc"
PREFERRED_PROVIDER_u-boot_mx6 = "u-boot-imx"

PREFERRED_PROVIDER_virtual/kernel_mx6 = "linux-imx"

PREFERRED_PROVIDER_virtual/libgl_mx6q = "imx-gpu-viv"
PREFERRED_PROVIDER_virtual/libgl_mx6dl = "imx-gpu-viv"
PREFERRED_PROVIDER_virtual/libgl_mx6sx = "imx-gpu-viv"
PREFERRED_PROVIDER_virtual/libgl_mx6sl= "mesa"

PREFERRED_PROVIDER_virtual/libgles1_mx6q = "imx-gpu-viv"
PREFERRED_PROVIDER_virtual/libgles2_mx6q = "imx-gpu-viv"
PREFERRED_PROVIDER_virtual/libgles1_mx6dl = "imx-gpu-viv"
PREFERRED_PROVIDER_virtual/libgles2_mx6dl = "imx-gpu-viv"
PREFERRED_PROVIDER_virtual/libgles1_mx6sx = "imx-gpu-viv"
PREFERRED_PROVIDER_virtual/libgles2_mx6sx = "imx-gpu-viv"
PREFERRED_PROVIDER_virtual/libgles1_mx6sl = "mesa"
PREFERRED_PROVIDER_virtual/libgles2_mx6sl = "mesa"

PREFERRED_PROVIDER_virtual/egl_mx6q = "imx-gpu-viv"
PREFERRED_PROVIDER_virtual/egl_mx6dl = "imx-gpu-viv"
PREFERRED_PROVIDER_virtual/egl_mx6sx = "imx-gpu-viv"
PREFERRED_PROVIDER_virtual/egl_mx6sl = "imx-gpu-viv"

PREFERRED_PROVIDER_virtual/libgal-x11_mx6 = "imx-gpu-viv"
PREFERRED_PROVIDER_virtual/libopenvg_mx6q = "imx-gpu-viv"
PREFERRED_PROVIDER_virtual/libopenvg_mx6dl = "imx-gpu-viv"
PREFERRED_PROVIDER_virtual/libopenvg_mx6sx = "imx-gpu-viv"
PREFERRED_PROVIDER_virtual/libopenvg_mx6sl = "imx-gpu-viv"

PREFERRED_PROVIDER_virtual/libg2d_mx6 = "imx-gpu-viv"

# Preferred Versions

FP_TAG = "${@base_contains("TUNE_FEATURES", "callconvention-hard", "-hfp", "-sfp", d)}"

PREFERRED_VERSION_imx-gpu-viv = "5.0.11.p4.4${FP_TAG}"
PREFERRED_VERSION_xf86-video-imxfb-vivante = "5.0.11.p4.4"

PREFERRED_VERSION_fsl-gpu-sdk_mx6 = "2.0"

PREFERRED_VERSION_imx-gpu-viv-kernel = "5.0.11.p4.4"

# set following because of override in meta-fsl-arm
PREFERRED_VERSION_directfb_mx6q = "1.7.4"
PREFERRED_VERSION_directfb_mx6dl = "1.7.4"
PREFERRED_VERSION_directfb_mx6sl = "1.7.4"
PREFERRED_VERSION_directfb_mx6sx = "1.7.4"

PREFERRED_VERSION_directfb-examples_mx6 = "1.7.0"
PREFERRED_VERSION_directfb-examples_mx6q = "1.7.0"
PREFERRED_VERSION_directfb-examples_mx6dl = "1.7.0"
PREFERRED_VERSION_directfb-examples_mx6s = "1.7.0"
PREFERRED_VERSION_directfb-examples_mx6sl = "1.7.0"
PREFERRED_VERSION_directfb-examples_mx6sx = "1.7.0"

# Use Wayland new version
PREFERRED_VERSION_wayland_mx6 = "1.6.0"
PREFERRED_VERSION_weston_mx6 = "1.6.0"
PREFERRED_VERSION_wayland-native = "1.6.0"

PREFERRED_VERSION_imx-lib_mx6 = "3.10.53-1.1.0"
PREFERRED_VERSION_imx-test = "3.14.28-1.0.0"
PREFERRED_VERSION_imx-vpu_mx6 = "5.4.28"
PREFERRED_VERSION_linux-imx_mx6 = "3.14.28"
PREFERRED_VERSION_mfgtool-linux-imx_mx6 = "3.14.28"
PREFERRED_VERSION_u-boot-imx_mx6 = "2014.04"
PREFERRED_VERSION_u-boot-imx-mfgtool_mx6 = "2014.04"
PREFERRED_VERSION_imx-uuc_mx6 = "0.5"

PREFERRED_VERSION_gst-fsl-plugin = "4.0.3"
PREFERRED_VERSION_libfslcodec = "4.0.3"
PREFERRED_VERSION_libfslparser = "4.0.3"
PREFERRED_VERSION_libfslvpuwrap = "1.0.58"

PREFERRED_VERSION_gst1.0-fsl-plugin = "4.0.3"

PREFERRED_VERSION_fsl-alsa-plugins = "1.0.25"
PREFERRED_VERSION_gst-plugins-gl = "0.10.3"

PREFERRED_VERSION_imx-kobs_mx6 = "3.14.28-1.0.0"
PREFERRED_VERSION_firmware-imx_mx6 = "3.14.28-1.0.0"
PREFERRED_VERSION_firmware-imx_mx5 = "3.14.28-1.0.0"

PREFERRED_VERSION_imx-lib_mx5 = "11.09.02"
PREFERRED_VERSION_imx-vpu_mx5 = "11.09.02"
```

## meta-imx/meta-sdk/conf/layer.conf
```bitbake
# We have a conf and classes directory, add to BBPATH
BBPATH .= ":${LAYERDIR}"

# We have a packages directory, add to BBFILES
BBFILES += "${LAYERDIR}/recipes-*/*/*.bb"

BBFILE_COLLECTIONS += "imx-sdk"
BBFILE_PATTERN_imx-sdk := "^${LAYERDIR}/"
BBFILE_PRIORITY_imx-sdk = "5"

# Let us add layer-specific bbappends which are only applied when that
# layer is included in our configuration
BBFILES += "${@' '.join('${LAYERDIR}/%s/recipes*/*/*.bbappend' % layer \
               for layer in BBFILE_COLLECTIONS.split())}"
BBFILES += "${@'${LAYERDIR}/recipes-*/*/*.bbappend' if \
    os.path.exists(d.getVar('BBFILE_PATTERN_imx', True).strip('^') + \
    'conf/machine/' + d.getVar('MACHINE', True) + '.conf') else ''}"
```

## meta-qoriq/meta-bsp/conf/distro/fsl-qoriq.conf
```bitbake
require conf/distro/poky.conf

DISTRO = "fsl-qoriq"
SDK_VENDOR = "-fslsdk"
SDK_VERSION = "QorIQ-SDK-V1.7"
MAINTAINER = "Freescale Yocto Team <meta-freescale@yoctoproject.org>"

TARGET_VENDOR = "-fsl"

SDK_NAME = "${DISTRO}-${TCLIBC}-${SDK_ARCH}-${TUNE_PKGARCH}"

SANITY_TESTED_DISTROS += " \
    Fedora-20 \n \
    CentOS-7.0.1406 \n \
    Debian-7.6 \n \
    LinuxMint-15 \n \
    openSUSE-project-13.1 \n \
    Ubuntu-14.04 \n \
"

include conf/distro/include/fsl-qoriq-base.inc

INHERIT += "own-mirrors"
SOURCE_MIRROR_URL ?= "http://git.freescale.com/source/"

POKY_DEFAULT_DISTRO_FEATURES_remove = " opengl ptest"
DISTRO_FEATURES_DEFAULT_remove = " pcmcia 3g"
DISTRO_FEATURES_DEFAULT_append = " benchmark vfat ext2 mtd \
    alsa perl ppp python usbhost virtualization db"

ERROR_QA = "dev-so debug-deps dev-deps debug-files arch la2 pkgconfig la perms rpaths staticdev ldflags"
```

## meta-qoriq/meta-bsp/conf/distro/include/fsl-qoriq-base.inc
```bitbake
# Freescale QorIQ BSP default versions
PREFERRED_VERSION_virtual/kernel_ls102xa = "3.12"
PREFERRED_VERSION_qemu = "1.7+fsl"
PREFERRED_VERSION_make = "3.81"
```

## meta-qoriq/meta-bsp/conf/machine/b4860qds-64b.conf
```bitbake
#@TYPE: Machine
#@NAME: Freescale B4860QDS-64B
#@SOC: b4860
#@DESCRIPTION: Machine configuration for running B4860QDS in 64-bit mode
#@MAINTAINER: Chunrong Guo <B40290@freescale.com>

require conf/machine/include/e6500-64b.inc

SOC_FAMILY = "b4:b4860"
UBOOT_CONFIG ??= "nor secure-boot"
UBOOT_CONFIG[nor] = "B4860QDS_config"
UBOOT_CONFIG[secure-boot] = "B4860QDS_SECURE_BOOT_config"
KERNEL_DEVICETREE ?= "b4860qds.dtb b4860qds-usdpaa.dtb"
KERNEL_DEFCONFIG ?= "${S}/arch/powerpc/configs/85xx/e6500rev2_defconfig"

JFFS2_ERASEBLOCK = "0x10000"
```

## meta-qoriq/meta-bsp/conf/machine/include/qoriq-arm.inc
```bitbake
require conf/machine/include/qoriq.inc

UBOOT_ENTRYPOINT = "0x80008000"

DEFAULTTUNE = "cortexa7hf-neon"

SERIAL_CONSOLES ?= "115200;ttyS0 115200;ttyS1 115200;ttyEHV0 115200;ttyLP0 115200;ttyAMA0"
SERIAL_CONSOLES_CHECK ?= "${SERIAL_CONSOLES}"

MACHINEOVERRIDES .= ":qoriq-arm"
```

## meta-qoriq/meta-bsp/conf/machine/include/qoriq-ppc.inc
```bitbake
require conf/machine/include/qoriq.inc

# The default version
PREFERRED_VERSION_ptpd = "2.3.1-rc2"
PREFERRED_VERSION_valgrind_e500v2 = "3.8.1+fsl"
PREFERRED_VERSION_qemu = "1.7+fsl"
PREFERRED_VERSION_openssl = "1.0.1i"

MACHINE_EXTRA_RRECOMMENDS += "udev-rules-qoriq"

SERIAL_CONSOLES ?= "115200;ttyS0 115200;ttyS1 115200;ttyEHV0"
SERIAL_CONSOLES_CHECK ?= "${SERIAL_CONSOLES}"

MACHINEOVERRIDES .= ":qoriq-ppc"
```
